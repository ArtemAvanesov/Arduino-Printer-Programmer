

#include <Wire.h>

#include <Eeprom24C01_02.h>



#define  eepromSize   //  eeprom 2 Kbit (256x8) eeprom / закомментировать если eeprom 1 Kbit (128x8)


byte incomingByte;

#ifdef eepromSize

byte inputBytes[] = {0x32, 0x00, 0x01, 0x03, 0x01, 0x01, 0x03, 0x00, 0x00, 0x00, 0xFF, 0xFF, 0xFF, 0xFF, 0xFF, 0xFF,
                     0x16, 0x10, 0x00, 0x00, 0x00, 0x00, 0x00, 0x00, 0x00, 0x00, 0x00, 0x00, 0x00, 0x00, 0x00, 0x00,
                     0x59, 0x36, 0x35, 0x36, 0x4D, 0x41, 0x30, 0x34, 0x37, 0x33, 0x34, 0x20, 0x00, 0x00, 0x00, 0x00,
                     0x00, 0x00, 0x00, 0x00, 0x00, 0x00, 0x00, 0x00, 0x00, 0x00, 0x00, 0x00, 0x00, 0x00, 0x00, 0x00,
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                     0x00, 0x00, 0x00, 0x00, 0x00, 0x00, 0x00, 0x00, 0x00, 0x00, 0x00, 0x00, 0x00, 0x00, 0x00, 0x00
                    };

#else

byte inputBytes[] = {0x32, 0x00, 0x01, 0x03, 0x01, 0x01, 0x03, 0x00, 0x00, 0x00, 0xFF, 0xFF, 0xFF, 0xFF, 0xFF, 0xFF,
                     0x16, 0x10, 0x00, 0x00, 0x00, 0x00, 0x00, 0x00, 0x00, 0x00, 0x00, 0x00, 0x00, 0x00, 0x00, 0x00,
                     0x59, 0x36, 0x35, 0x36, 0x4D, 0x41, 0x30, 0x34, 0x37, 0x33, 0x34, 0x20, 0x00, 0x00, 0x00, 0x00,
                     0x00, 0x00, 0x00, 0x00, 0x00, 0x00, 0x00, 0x00, 0x00, 0x00, 0x00, 0x00, 0x00, 0x00, 0x00, 0x00,
                     0x00, 0x00, 0x00, 0x00, 0x00, 0x00, 0x00, 0x00, 0x00, 0x00, 0x00, 0x00, 0x00, 0x00, 0x00, 0x00,
                     0x00, 0x00, 0x00, 0x00, 0x00, 0x00, 0x00, 0x00, 0x00, 0x00, 0x00, 0x00, 0x00, 0x00, 0x00, 0x00,
                     0x00, 0x00, 0x00, 0x00, 0x00, 0x00, 0x00, 0x00, 0x00, 0x00, 0x00, 0x00, 0x00, 0x00, 0x00, 0x00,
                     0x00, 0x00, 0x00, 0x00, 0x00, 0x00, 0x00, 0x00, 0x00, 0x00, 0x00, 0x00, 0x00, 0x00, 0x00, 0x00
                    };
#endif

const byte count = (sizeof(inputBytes) / sizeof(inputBytes[0])) - 1;
byte adr;


void setup()
{
  // Initialize serial communication.
  Serial.begin(115200);
  Wire.begin();

  adr = i2c_scan();
  if (adr != 0) {
    Serial.println("W-write eeprom (reset)");
    Serial.println("R-read eeprom");
  }

}
void READ () {
  static Eeprom24C01_02 eeprom(adr);
  eeprom.initialize();
  int s = 0;
  Serial.println("Read bytes:");
  for (int i = 0; i <= count; i++)
  {
    byte outputBytes = eeprom.readByte(i);
    if (outputBytes < 16) Serial.print("0");
    Serial.print(outputBytes, HEX);
    s++;
    if (s == 16) {
      Serial.println("");
      s = 0;
    }
    else  Serial.print(" ");
  }
}

void WRITE () {
  static Eeprom24C01_02 eeprom(adr);
  eeprom.initialize();
  // Write a byte at address 0 in EEPROM memory.
  Serial.println("Write byte to EEPROM memory...");
  for (int i = 0; i <= count; i++) {
    eeprom.writeByte(i, inputBytes[i]);
    delay(10);  // Write cycle time (tWR). See EEPROM memory datasheet for more details.
  }
  Serial.println("Ok.");
}


byte i2c_scan () {

  byte error, address;
  int nDevices;

  Serial.println("Scanning...");

  nDevices = 0;
  for (address = 1; address < 127; address++ )
  {
    // The i2c_scanner uses the return value of
    // the Write.endTransmisstion to see if
    // a device did acknowledge to the address.
    Wire.beginTransmission(address);
    error = Wire.endTransmission();

    if (error == 0)
    {
      Serial.print("I2C device found at address 0x");
      if (address < 16)
        Serial.print("0");
      Serial.print(address, HEX);
      Serial.println("  !");
      Serial.println("");
      nDevices++;
      return address;
    }
    else if (error == 4)
    {
      Serial.print("Unknown error at address 0x");
      if (address < 16)
        Serial.print("0");
      Serial.println(address, HEX);
    }
  }
  if (nDevices == 0)
    Serial.println("No I2C devices found\n");
  else
    Serial.println("done\n");
  return 0;
}

void loop()
{
  if (Serial.available() > 0 & adr != 0) {
    incomingByte = Serial.read();
    if (incomingByte == 'W') WRITE();
    if (incomingByte == 'R') READ ();

  }
}
